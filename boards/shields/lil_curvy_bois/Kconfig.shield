## boards/shields/lil_curvy_bois/Kconfig.shield
```kconfig
config SHIELD_LIL_CURVY_BOIS_LEFT
    def_bool $(shields_list_contains,lil_curvy_bois_left)

config SHIELD_LIL_CURVY_BOIS_RIGHT
    def_bool $(shields_list_contains,lil_curvy_bois_right)
```
