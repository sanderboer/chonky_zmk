#include <dt-bindings/zmk/matrix_transform.h>
#include "lil_chonky_bois.dtsi"

&default_transform { 
    col-offset = <5>;
};

&kscan0 {
       col-gpios
            = <&gpio1 13 GPIO_ACTIVE_HIGH>
            , <&gpio0 2 GPIO_ACTIVE_HIGH>
            , <&gpio0 29 GPIO_ACTIVE_HIGH>
            , <&gpio0 26 GPIO_ACTIVE_HIGH>
            , <&gpio0 30 GPIO_ACTIVE_HIGH>
            ;
};
